## CMakeLists.txt
```
# Copyright (c) 2023 Google LLC
# SPDX-License-Identifier: Apache-2.0

cmake_minimum_required(VERSION 3.20)
set(pw_third_party_nanopb_ADD_SUBDIRECTORY ON CACHE BOOL "" FORCE)
find_package(Zephyr REQUIRED HINTS $ENV{ZEPHYR_BASE})

project(app)
enable_language(C CXX)

# Define the proto library
include(${ZEPHYR_PIGWEED_MODULE_DIR}/pw_protobuf_compiler/proto.cmake)
pw_proto_library(rpc_demo.protos
  SOURCES
    proto/demo.proto
  INPUTS
    proto/demo.options
)

zephyr_link_libraries(
    rpc_demo.protos.nanopb
    rpc_demo.protos.nanopb_rpc
)

target_include_directories(app
  PRIVATE
    include
)

target_sources(app
  PRIVATE
    src/main.cc
)

add_subdirectory(remoteconfig)
target_link_libraries(app PRIVATE pw_system.hdlc_rpc_server remoteconfig)

# Add custom logic to generate database.bin
# The application expects it to be in the binary dir.
add_custom_target(database_binary
DEPENDS
  ${CMAKE_BINARY_DIR}/database.csv
)
add_custom_command(
  OUTPUT ${CMAKE_BINARY_DIR}/database.csv
  COMMAND
  ${PYTHON_EXECUTABLE}
  $ENV{PW_ROOT}/pw_tokenizer/py/pw_tokenizer/database.py
  create
  --force
  --type csv
  -d ${CMAKE_BINARY_DIR}/database.csv
  ${CMAKE_BINARY_DIR}/zephyr/zephyr_pre0.elf
  DEPENDS zephyr_pre0
)
add_dependencies(${logical_target_for_zephyr_elf} database_binary)

target_include_directories(app PRIVATE remoteconfig)
#add_subdirectory(service)
#add_subdirectory_ifdef(CONFIG_LOCALITY_LPC local)
#add_subdirectory_ifdef(CONFIG_LOCALITY_RPC remote)
```

## Kconfig
```
# Copyright (c) 2023 Google LLC
# SPDX-License-Identifier: Apache-2.0

menu "Zephyr"
source "Kconfig.zephyr"
endmenu

module = APP
module-str = APP
source "subsys/logging/Kconfig.template.log_config"
```

## prj.conf
```kconfig
# Copyright (c) 2023 Google LLC
# SPDX-License-Identifier: Apache-2.0

CONFIG_ASSERT=n
CONFIG_NANOPB=y
CONFIG_LOG=y
CONFIG_LOG_DEFAULT_LEVEL=2
CONFIG_LOG_BACKEND_SHOW_COLOR=n
CONFIG_LOG_BACKEND_FORMAT_TIMESTAMP=y

CONFIG_PIGWEED_ASSERT=y
CONFIG_PIGWEED_BYTES=y
CONFIG_PIGWEED_CHECKSUM=y
CONFIG_PIGWEED_CHRONO_SYSTEM_CLOCK=y
CONFIG_PIGWEED_CONTAINERS=y
CONFIG_PIGWEED_FUNCTION=y
CONFIG_PIGWEED_HDLC_RPC=y
CONFIG_PIGWEED_THREAD_SLEEP=y
CONFIG_PIGWEED_INTERRUPT_CONTEXT=y
# CONFIG_PIGWEED_LOG_ZEPHYR=y
# CONFIG_PIGWEED_LOG_TOKENIZED=y
CONFIG_PIGWEED_LOG_TOKENIZED_RPC=y
CONFIG_PIGWEED_POLYFILL=y
CONFIG_PIGWEED_POLYFILL_OVERRIDES=y
CONFIG_PIGWEED_PREPROCESSOR=y
CONFIG_PIGWEED_RESULT=y
CONFIG_PIGWEED_ROUTER_PACKET_PARSER=y
CONFIG_PIGWEED_RPC_COMMON=y
CONFIG_PIGWEED_SPAN=y
CONFIG_PIGWEED_STATUS=y
CONFIG_PIGWEED_STREAM=y
CONFIG_PIGWEED_STRING=y
CONFIG_PIGWEED_SYNC_MUTEX=y
CONFIG_PIGWEED_VARINT=y
CONFIG_CPP=y
CONFIG_STD_CPP17=y
CONFIG_CPP_MAIN=y
CONFIG_CONSOLE_SUBSYS=y
CONFIG_CONSOLE_GETCHAR=y
```

## src/main.cc
```c
#define PW_LOG_MODULE_NAME "APP"

#include <zephyr/kernel.h>
#include <zephyr/logging/log.h>
#include <pw_log/log.h>
#ifdef CONFIG_PIGWEED_LOG_TOKENIZED_RPC
#include <pw_system/init.h>
#include <pw_system/rpc_server.h>
#include "remoteconfig.hh"
#endif
#include <zephyr/logging/log_core.h>

namespace pw::system {

// This will run once after pw::system::Init() completes. This callback must
// return or it will block the work queue.
void UserAppInit() {
  Z_LOG_PRINTK(/*_is_raw=*/0, "UserAppInit Pigweed is fun\n");
  PW_LOG_INFO("Pigweed is fun!");
}

}  // namespace pw::system

int main(void) {
//  int count = 0;
#ifdef CONFIG_PIGWEED_LOG_TOKENIZED_RPC
  pw::system::Init();
  rpc_demo::remoteconfig::RemoteConfigService remoteConfigService;
  pw::system::GetRpcServer().RegisterService(remoteConfigService);
#endif

  while(true) {
    PW_LOG_DEBUG("Hello Pigweed DEBUG");
    PW_LOG_INFO("Hello Pigweed INFO");
    PW_LOG_WARN("Hello Pigweed WARN");
    PW_LOG_ERROR("Hello Pigweed ERROR");

    LOG_DBG("Hello Zephyr DBG");
    LOG_INF("Hello Zephyr INF");
    LOG_WRN("Hello Zephyr WRN");
    LOG_ERR("Hello Zephyr ERR");

    k_sleep(K_MSEC(5000));
  }
  return 0;
}
```

## include/client.h
```c
/* Copyright 2023 The ChromiumOS Authors.
 * Use of this source code is governed by a BSD-style license that can be
 * found in the LICENSE file.
 */

#pragma once

#include "proto/demo.rpc.pb.h"

rpc_demo::pw_rpc::nanopb::DemoService::Client service_client;
```
