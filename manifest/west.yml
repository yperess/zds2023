## manifest/west.yml
```yaml
# Copyright (c) 2023 Google LLC
# SPDX-License-Identifier: Apache-2.0

manifest:
  remotes:
    - name: zephyrproject-rtos
      url-base: https://github.com/zephyrproject-rtos
    - name: pigweed-git
      url-base: https://pigweed.googlesource.com/pigweed

  projects:
    - name: zephyr
      remote: zephyrproject-rtos
      revision: main
      clone-depth: 50
      import: true
    - name: pigweed
      remote: pigweed-git
      revision: main
      clone-depth: 50
```

## samples/microservices/rpc/Kconfig
```kconfig
# Copyright (c) 2023 Google LLC
# SPDX-License-Identifier: Apache-2.0

choice RPC_TYPE
    prompt "RPC type"

config RPC_TYPE_NANOPB
    bool "Uses nanopb to generate the RPC type"

config RPC_TYPE_RAW
    bool "Uses raw byte spans to generate the RPC type"

endchoice
```
